## west.yml
```
# The west manifest file for upstream Zephyr.
#
# The per-installation west configuration file, .west/config, sets the
# path to the project containing this file in the [manifest] section's
# "path" variable.
#
# You are free to create your own manifest files and put them in any
# repository you want, to create your own custom Zephyr installations.
# For example, you could create a manifest file in your own out of
# tree application directory, which would pull this zephyr repository
# in as an ordinary project.
#
# You can pass your manifest repositories to west init when creating a
# new Zephyr installation. See the west documentation for more
# information.

manifest:
  defaults:
    remote: upstream

  remotes:
    - name: upstream
      url-base: https://github.com/zephyrproject-rtos

  #
  # Please add items below based on alphabetical order
  projects:
    - name: hal_atmel
      revision: 5a44c9d54dffd685fb6664a646922cfe41c5cf8e
      path: modules/hal/atmel
    - name: canopennode
      path: modules/lib/canopennode
      revision: 5c6b0566d56264efd4bf23ed58bc7cb8b32fe063
    - name: ci-tools
      revision: 0706b1e8be917b80e50be6e8cd86befe5e9deccf
      path: tools/ci-tools
    - name: civetweb
      revision: 99129c5efc907ea613c4b73ccff07581feb58a7a
      path: modules/lib/civetweb
    - name: esp-idf
      revision: 6835bfc741bf15e98fb7971293913f770df6081f
      path: modules/hal/esp-idf
    - name: fatfs
      revision: 9ee6b9b9511151d0d64a74d532d39c6f2bbd4f16
      path: modules/fs/fatfs
    - name: hal_cypress
      revision: a12d92816a53a521d79cefcf5c38b9dc8a4fed6e
      path: modules/hal/cypress
    - name: hal_nordic
      revision: 12d7647870888e4cb0e421f2b26884c2e76915ac
      path: modules/hal/nordic
    - name: hal_openisa
      revision: 3b54187649cc9b37161d49918f1ad28ff7c7f830
      path: modules/hal/openisa
    - name: hal_microchip
      revision: 03c8819ac3105cc2aee295a8d330de0e665b705f
      path: modules/hal/microchip
    - name: hal_silabs
      revision: 9a3fe1af3a14bf88c86b9cda3bf2a0921d5a97a1
      path: modules/hal/silabs
    - name: hal_st
      revision: fa481784b3c49780f18d50bafe00390ccb62b2ec
      path: modules/hal/st
    - name: hal_stm32
      revision: dee4413253623ec575bb8b58abd56f91afe903bb
      path: modules/hal/stm32
    - name: hal_ti
      revision: b25d4b83b16e52f501f8cd360f4efb8c31ffb578
      path: modules/hal/ti
    - name: libmetal
      revision: 45e630d6152824f807d3f919958605c4626cbdff
      path: modules/hal/libmetal
    - name: lvgl
      revision: 74fc2e753a997bd71cefa34dd9c56dcb954b42e2
      path: modules/lib/gui/lvgl
    - name: mbedtls
      revision: cf7020eb4c7ef93319f2d6d2403a21e12a879bf6
      path: modules/crypto/mbedtls
    - name: mcuboot
      revision: v1.5.0
      path: bootloader/mcuboot
    - name: mcumgr
      revision: d4e97cd4fc80ff949415062b1c83fd42929e8fe4
      path: modules/lib/mcumgr
    - name: net-tools
      revision: 4bff01084d225996e4aae84b98be5969e2f9f33d
      path: tools/net-tools
    - name: hal_nxp
      revision: 3e3f20e7de7606d735cdeefe21d5f2a51bf06095
      path: modules/hal/nxp
    - name: open-amp
      revision: 9b591b289e1f37339bd038b5a1f0e6c8ad39c63a
      path: modules/lib/open-amp
    - name: loramac-node
      revision: 29e516ec585b1a909af2b5f1c60d83e7d4d563e3
      path: modules/lib/loramac-node
    - name: openthread
      revision: 3c6191eb4e8ca44b5f4eeaa696837bce14e83c69
      path: modules/lib/openthread
    - name: segger
      revision: 6fcf61606d6012d2c44129edc033f59331e268bc
      path: modules/debug/segger
    - name: tinycbor
      path: modules/lib/tinycbor
      revision: 0fc68fceacd1efc1ce809c5880c380f3d98b7b6e
    - name: littlefs
      path: modules/fs/littlefs
      revision: fe9572dd5a9fcf93a249daa4233012692bd2881d
    - name: mipi-sys-t
      path: modules/debug/mipi-sys-t
      revision: baf51863f19f009b92e762115ba5572a5b996b92
    - name: nrf_hw_models
      path: modules/bsim_hw_models/nrf_hw_models
      revision: fec69703cb1ca06fcdab6d5fde01274f0fc5c759
    - name: hal_xtensa
      revision: 382b309b481adc85dd517d50b8a458bcb86f15d4
      path: modules/hal/xtensa
    - name: edtt
      path: tools/edtt
      revision: 8d3ebb28863b252731b0813dff45a3d71b31a6e7

  self:
    path: peripheral
```

## prj.conf
```kconfig
# Incresed stack due to settings API usage
CONFIG_SYSTEM_WORKQUEUE_STACK_SIZE=2048

CONFIG_BT=y
CONFIG_BT_DEBUG_LOG=y
CONFIG_BT_SMP=y
CONFIG_BT_SIGNING=y
CONFIG_BT_PERIPHERAL=y
CONFIG_BT_CENTRAL=y
CONFIG_BT_GATT_DIS=y
CONFIG_BT_ATT_PREPARE_COUNT=5
CONFIG_BT_GATT_BAS=y
CONFIG_BT_GATT_HRS=y
CONFIG_BT_PRIVACY=y
CONFIG_BT_DEVICE_NAME="Zephyr Peripheral Sample Long Name"
CONFIG_BT_DEVICE_APPEARANCE=833
CONFIG_BT_DEVICE_NAME_DYNAMIC=y
CONFIG_BT_DEVICE_NAME_MAX=65

CONFIG_BT_KEYS_OVERWRITE_OLDEST=y
CONFIG_BT_SETTINGS=y
CONFIG_FLASH=y
CONFIG_FLASH_PAGE_LAYOUT=y
CONFIG_FLASH_MAP=y
CONFIG_NVS=y
CONFIG_SETTINGS=y

CONFIG_CONSOLE_SUBSYS=y
CONFIG_CONSOLE_GETCHAR=y
CONFIG_CONSOLE_GETCHAR_BUFSIZE=64
CONFIG_CONSOLE_PUTCHAR_BUFSIZE=512
CONFIG_LOG_DEFAULT_LEVEL=4

CONFIG_DISPLAY=y
CONFIG_GROVE_LCD_RGB=y

CONFIG_BT_MAX_PAIRED=2

CONFIG_MAIN_STACK_SIZE=4096
CONFIG_HEAP_MEM_POOL_SIZE=4096

# network
CONFIG_NETWORKING=y
```

## src/main.c
~~~~c
/* main.c - Application main entry point */

/*
 * Copyright (c) 2015-2016 Intel Corporation
 *
 * SPDX-License-Identifier: Apache-2.0
 */

#include <zephyr/types.h>
#include <stddef.h>
#include <string.h>
#include <errno.h>
#include <sys/printk.h>
#include <sys/byteorder.h>
#include <zephyr.h>

#include <settings/settings.h>

#include <bluetooth/bluetooth.h>
#include <bluetooth/hci.h>
#include <bluetooth/conn.h>
#include <bluetooth/uuid.h>
#include <bluetooth/gatt.h>
#include <bluetooth/services/bas.h>
#include <bluetooth/services/hrs.h>

#include "cts.h"

// IFW below
#include "fsm_handle.h"
// #include "fsm_test.h"
// IFW above

/*
They generated these UUID as
(venv) upgautam@amd:~/Downloads/BlueSWAT-Artifact$ python
Python 3.12.3 (main, Jun 18 2025, 17:59:45) [GCC 13.3.0] on linux
Type "help", "copyright", "credits" or "license" for more information.
>>> import uuid;
>>> print(uuid.uuid4())
ef785d4d-b961-4810-af5e-a5d5ac2a24b0

And then for other two UUIDs, they didn't generate they only change the second value (see 0/1/2)
This is not globally unique but okay for local development/testing

vnd_uuid:     f0debc9a-7856-3412-7856-341278563412
vnd_enc_uuid: f1debc9a-7856-3412-7856-341278563412
vnd_auth_uuid:f2debc9a-7856-3412-7856-341278563412

*/

/* Custom Service Variables */
//these variables are used in BT GATT Service object
static struct bt_uuid_128 vnd_uuid = BT_UUID_INIT_128(
    0xf0, 0xde, 0xbc, 0x9a, 0x78, 0x56, 0x34, 0x12,
    0x78, 0x56, 0x34, 0x12, 0x78, 0x56, 0x34, 0x12);

static struct bt_uuid_128 vnd_enc_uuid = BT_UUID_INIT_128(
    0xf1, 0xde, 0xbc, 0x9a, 0x78, 0x56, 0x34, 0x12,
    0x78, 0x56, 0x34, 0x12, 0x78, 0x56, 0x34, 0x12);

static struct bt_uuid_128 vnd_auth_uuid = BT_UUID_INIT_128(
    0xf2, 0xde, 0xbc, 0x9a, 0x78, 0x56, 0x34, 0x12,
    0x78, 0x56, 0x34, 0x12, 0x78, 0x56, 0x34, 0x12);

//[0x56, 0x65, 0x6E, 0x64, 0x6F, 0x72]. This vnd_value array is used in BT GATT Characteristic object
static u8_t vnd_value[] = {'V', 'e', 'n', 'd', 'o', 'r'};

//used to read attr value up to length offset and paste it into buf up to length len
// conn is not used here.
static ssize_t read_vnd(struct bt_conn *conn, const struct bt_gatt_attr *attr,
                        void *buf, u16_t len, u16_t offset)
{
    const char *value = attr->user_data;

    return bt_gatt_attr_read(conn, attr, buf, len, offset, value,
                             strlen(value));
}

static ssize_t write_vnd(struct bt_conn *conn, const struct bt_gatt_attr *attr,
                         const void *buf, u16_t len, u16_t offset,
                         u8_t flags)
{
    u8_t *value = attr->user_data;

    //vnd_value is the large storage buffer that is filled by several write_vnd()
    //value here means the address because this is pointer.
    //offset starts from value, writes up to value+len, in next write, it writes from value+offset upto value+offset+len
    if (offset + len > sizeof(vnd_value))
    {
        return BT_GATT_ERR(BT_ATT_ERR_INVALID_OFFSET);
    }

    memcpy(value + offset, buf, len);

    return len;
}

static u8_t simulate_vnd; //true/false flag
static u8_t indicating; //true/false flag
static struct bt_gatt_indicate_params ind_params;

//this is a callback when Client Characteristics Configuration (CCC) values change
// Called when client enables/disables indications; sets flag to start/stop indication simulation
// simulate_vnd = 1 means indications enabled, 0 means disabled
static void vnd_ccc_cfg_changed(const struct bt_gatt_attr *attr, u16_t value)
{
    simulate_vnd = (value == BT_GATT_CCC_INDICATE) ? 1 : 0;
}

// Callback called when a GATT indication is confirmed by the client or fails
// Prints success/fail message and clears the 'indicating' flag to allow next indication

// This function is passed to bt_gatt_indicate() and invoked when the BLE client acknowledges (or rejects) the indication.
// Setting indicating = 0U marks that the indication is done, so your code can send another one.

//Indication is a way for a BLE server (like your device) to send reliable, confirmed asynchronous messages to a connected client.
//Unlike notifications, which are unacknowledged and "fire-and-forget," indications require the client to acknowledge receipt.
static void indicate_cb(struct bt_conn *conn, const struct bt_gatt_attr *attr,
                        u8_t err)
{
    printk("Indication %s\n", err != 0U ? "fail" : "success");
    indicating = 0U;
}


//reading large logic
#define MAX_DATA 74
static u8_t vnd_long_value[] = {
    'V', 'e', 'n', 'd', 'o', 'r', ' ', 'd', 'a', 't', 'a', '1',
    'V', 'e', 'n', 'd', 'o', 'r', ' ', 'd', 'a', 't', 'a', '2',
    'V', 'e', 'n', 'd', 'o', 'r', ' ', 'd', 'a', 't', 'a', '3',
    'V', 'e', 'n', 'd', 'o', 'r', ' ', 'd', 'a', 't', 'a', '4',
    'V', 'e', 'n', 'd', 'o', 'r', ' ', 'd', 'a', 't', 'a', '5',
    'V', 'e', 'n', 'd', 'o', 'r', ' ', 'd', 'a', 't', 'a', '6',
    '.', ' '};

static ssize_t read_long_vnd(struct bt_conn *conn,
                             const struct bt_gatt_attr *attr, void *buf,
                             u16_t len, u16_t offset)
{
    const char *value = attr->user_data;

    return bt_gatt_attr_read(conn, attr, buf, len, offset, value,
                             sizeof(vnd_long_value));
}

static ssize_t write_long_vnd(struct bt_conn *conn,
                              const struct bt_gatt_attr *attr, const void *buf,
                              u16_t len, u16_t offset, u8_t flags)
{
    u8_t *value = attr->user_data;

    if (flags & BT_GATT_WRITE_FLAG_PREPARE)
    {
        return 0;
    }

    if (offset + len > sizeof(vnd_long_value))
    {
        return BT_GATT_ERR(BT_ATT_ERR_INVALID_OFFSET);
    }

    memcpy(value + offset, buf, len);

    return len;
}

static const struct bt_uuid_128 vnd_long_uuid = BT_UUID_INIT_128(
    0xf3, 0xde, 0xbc, 0x9a, 0x78, 0x56, 0x34, 0x12,
    0x78, 0x56, 0x34, 0x12, 0x78, 0x56, 0x34, 0x12);

static struct bt_gatt_cep vnd_long_cep = {
    .properties = BT_GATT_CEP_RELIABLE_WRITE,
};

static int signed_value;

static ssize_t read_signed(struct bt_conn *conn, const struct bt_gatt_attr *attr,
                           void *buf, u16_t len, u16_t offset)
{
    const char *value = attr->user_data;

    return bt_gatt_attr_read(conn, attr, buf, len, offset, value,
                             sizeof(signed_value));
}

static ssize_t write_signed(struct bt_conn *conn, const struct bt_gatt_attr *attr,
                            const void *buf, u16_t len, u16_t offset,
                            u8_t flags)
{
    u8_t *value = attr->user_data;

    if (offset + len > sizeof(signed_value))
    {
        return BT_GATT_ERR(BT_ATT_ERR_INVALID_OFFSET);
    }

    memcpy(value + offset, buf, len);

    return len;
}

static const struct bt_uuid_128 vnd_signed_uuid = BT_UUID_INIT_128(
    0xf3, 0xde, 0xbc, 0x9a, 0x78, 0x56, 0x34, 0x13,
    0x78, 0x56, 0x34, 0x12, 0x78, 0x56, 0x34, 0x13);

static const struct bt_uuid_128 vnd_write_cmd_uuid = BT_UUID_INIT_128(
    0xf4, 0xde, 0xbc, 0x9a, 0x78, 0x56, 0x34, 0x12,
    0x78, 0x56, 0x34, 0x12, 0x78, 0x56, 0x34, 0x12);

static ssize_t write_without_rsp_vnd(struct bt_conn *conn,
                                     const struct bt_gatt_attr *attr,
                                     const void *buf, u16_t len, u16_t offset,
                                     u8_t flags)
{
    u8_t *value = attr->user_data;

    /* Write request received. Reject it since this char only accepts
     * Write Commands.
     */
    if (!(flags & BT_GATT_WRITE_FLAG_CMD))
    {
        return BT_GATT_ERR(BT_ATT_ERR_WRITE_REQ_REJECTED);
    }

    if (offset + len > sizeof(vnd_value))
    {
        return BT_GATT_ERR(BT_ATT_ERR_INVALID_OFFSET);
    }

    memcpy(value + offset, buf, len);

    return len;
}

//large value logic finished

/* Vendor Primary Service Declaration */
/*
 This snippet defines a complete custom Bluetooth Low Energy (BLE) service using Zephyr’s GATT API macros. It creates a Vendor Primary Service identified by a custom 128-bit UUID (vnd_uuid). Inside this service, multiple characteristics are declared — each representing a piece of data or functionality exposed to connected BLE clients.

Each characteristic has its own UUID and supports different operations like read, write, indicate,
 or write without response, and each enforces specific security permissions such as encryption or
authentication for accessing or modifying the data. For example, one characteristic supports encrypted
read/write with indication capability, allowing the server to notify clients reliably; another supports
long writes with extended properties, which handle large data transfers in chunks. The service also includes
CCC (Client Characteristic Configuration) descriptors,
which let clients enable or disable notifications or indications dynamically.
*/
BT_GATT_SERVICE_DEFINE(vnd_svc,
                       BT_GATT_PRIMARY_SERVICE(&vnd_uuid),
                       BT_GATT_CHARACTERISTIC(&vnd_enc_uuid.uuid,
                                              BT_GATT_CHRC_READ | BT_GATT_CHRC_WRITE |
                                                  BT_GATT_CHRC_INDICATE,
                                              BT_GATT_PERM_READ_ENCRYPT |
                                                  BT_GATT_PERM_WRITE_ENCRYPT,
                                              read_vnd, write_vnd, vnd_value),
                       BT_GATT_CCC(vnd_ccc_cfg_changed,
                                   BT_GATT_PERM_READ | BT_GATT_PERM_WRITE_ENCRYPT),
                       BT_GATT_CHARACTERISTIC(&vnd_auth_uuid.uuid,
                                              BT_GATT_CHRC_READ | BT_GATT_CHRC_WRITE,
                                              BT_GATT_PERM_READ_AUTHEN |
                                                  BT_GATT_PERM_WRITE_AUTHEN,
                                              read_vnd, write_vnd, vnd_value),
                       BT_GATT_CHARACTERISTIC(&vnd_long_uuid.uuid, BT_GATT_CHRC_READ | BT_GATT_CHRC_WRITE | BT_GATT_CHRC_EXT_PROP,
                                              BT_GATT_PERM_READ | BT_GATT_PERM_WRITE |
                                                  BT_GATT_PERM_PREPARE_WRITE,
                                              read_long_vnd, write_long_vnd, &vnd_long_value),
                       BT_GATT_CEP(&vnd_long_cep),
                       BT_GATT_CHARACTERISTIC(&vnd_signed_uuid.uuid, BT_GATT_CHRC_READ | BT_GATT_CHRC_WRITE | BT_GATT_CHRC_AUTH,
                                              BT_GATT_PERM_READ | BT_GATT_PERM_WRITE,
                                              read_signed, write_signed, &signed_value),
                       BT_GATT_CHARACTERISTIC(&vnd_write_cmd_uuid.uuid,
                                              BT_GATT_CHRC_WRITE_WITHOUT_RESP,
                                              BT_GATT_PERM_WRITE, NULL,
                                              write_without_rsp_vnd, &vnd_value), );



/*
This code snippet defines a Bluetooth Low Energy (BLE) advertising data array named ad[], which specifies
information broadcasted by the device to nearby scanners. The first entry sets the advertising flags,
indicating that the device is in general discoverable mode and does not support classic Bluetooth (BR/EDR),
signaling it is a BLE-only device. The second entry advertises a list of standard 16-bit service UUIDs,
representing common BLE services such as heart rate and battery services, which helps clients identify
the device’s capabilities quickly. The third entry includes a custom 128-bit service UUID, indicating
that the device offers a vendor-specific service beyond the standard profiles. Together, this advertising data
allows other BLE-enabled devices or applications to discover and recognize
the device’s supported services and its BLE-only nature before establishing a connection.
*/
static const struct bt_data ad[] = {
    BT_DATA_BYTES(BT_DATA_FLAGS, (BT_LE_AD_GENERAL | BT_LE_AD_NO_BREDR)),
    BT_DATA_BYTES(BT_DATA_UUID16_ALL,
                  0x0d, 0x18, 0x0f, 0x18, 0x05, 0x18),
    BT_DATA_BYTES(BT_DATA_UUID128_ALL,
                  0xf0, 0xde, 0xbc, 0x9a, 0x78, 0x56, 0x34, 0x12,
                  0x78, 0x56, 0x34, 0x12, 0x78, 0x56, 0x34, 0x12),
};

/*
This function connected is a callback that runs when a Bluetooth connection attempt completes. It receives a connection
object and an error code. If err is nonzero, it means the connection failed, so it prints an error message
with the error code. Otherwise, if err is zero, it indicates a successful connection, and the function prints
 "Connected". Essentially, it notifies whether the BLE device successfully connected or encountered an error
during the connection process.
*/
static void connected(struct bt_conn *conn, u8_t err)
{
    if (err)
    {
        printk("Connection failed (err 0x%02x)\n", err);
    }
    else
    {
        printk("Connected\n");
    }
}

static void disconnected(struct bt_conn *conn, u8_t reason)
{
    printk("Disconnected (reason 0x%02x)\n", reason);
}

static struct bt_conn_cb conn_callbacks = {
    .connected = connected,
    .disconnected = disconnected,
};

static void bt_ready(void)
{
    int err;

    cts_init();

    if (IS_ENABLED(CONFIG_SETTINGS))
    {
        settings_load();
    }

    err = bt_le_adv_start(BT_LE_ADV_CONN_NAME, ad, ARRAY_SIZE(ad), NULL, 0);

    if (err)
    {
        printk("Advertising failed to start (err %d)\n", err);
        return;
    }

    printk("(DEBUG_LOG) Advertising successfully started\n");
}

static void auth_passkey_display(struct bt_conn *conn, unsigned int passkey)
{
    char addr[BT_ADDR_LE_STR_LEN];

    bt_addr_le_to_str(bt_conn_get_dst(conn), addr, sizeof(addr));

    printk("Passkey for %s: %06u\n", addr, passkey);
}

static void auth_cancel(struct bt_conn *conn)
{
    char addr[BT_ADDR_LE_STR_LEN];

    bt_addr_le_to_str(bt_conn_get_dst(conn), addr, sizeof(addr));

    printk("Pairing cancelled: %s\n", addr);
}

static struct bt_conn_auth_cb auth_cb_display = {
    .passkey_display = auth_passkey_display,
    .passkey_entry = NULL,
    .cancel = auth_cancel,
};

//battery service related -- this is a type of BLE GATT service
static void bas_notify(void)
{
    u8_t battery_level = bt_gatt_bas_get_battery_level();

    battery_level--;

    if (!battery_level)
    {
        battery_level = 100U;
    }

    bt_gatt_bas_set_battery_level(battery_level);
}

//heart rate related  -- this is a type of BLE GATT service
static void hrs_notify(void)
{
    static u8_t heartrate = 90U;

    /* Heartrate measurements simulation */
    heartrate++;
    if (heartrate == 160U)
    {
        heartrate = 90U;
    }

    bt_gatt_hrs_notify(heartrate);
}

void main(void)
{
    int err;

    // LL init here
    //entry point to initialize zephyr bluetooth subsystem (i.e., controller+host stacks)
    err = bt_enable(NULL); //init

    // BlueSWAT: IFW below
    // BlueSWAT:  enable IoT firewall Finite State Machine
    //Look here: /home/upgautam/Downloads/BlueSWAT-Artifact/ZephyrOS/zephyr/firewall/core
/*
# eBPF Firewall Library

This directory contains eBPF programs and tools of BleFSM.

## eBPF library

IoTFirewallCore/ZephyrOS/zephyr/firewall/libebpf/ebpf-src

## eBPF C source code

IoTFirewallCore/ZephyrOS/zephyr/firewall/policy/ebpf_code

## eBPF bytecode

IoTFirewallCore/ZephyrOS/zephyr/firewall/policy/include

## Build

Run the following command to build eBPF C program:

```
# IoTFirewallCore/ZephyrOS/zephyr/firewall/policy
$ ./compile.sh cve_2020_10069
```

The generated bytecode will be written to C head files in policy/include. The script is tested under WSL, so don't forget to set line termination characters to LF.

## Reference

https://github.com/uw-unsat/jitterbug
*/
    ifw_fsm_enable(JIT_OFF);

    // run test
    // test_local_conn_chan_hop();
    // test_all_mem();
    // test_runtime_overhead();
    // IFW above

    if (err)
    {
        printk("Bluetooth init failed (err %d)\n", err);
        return;
    }

    printk("Bluetooth init Here\n");

    //Logic after init is done
    //Logic can include starting advertising, logging, setting up GATT services etc.
    bt_ready();

    //registers connection and authentication related callbacks
    bt_conn_cb_register(&conn_callbacks);
    bt_conn_auth_cb_register(&auth_cb_display);

    /* Implement notification. At the moment there is no suitable way
     * of starting delayed work so we do it here
     */

    /*
	This main loop periodically send GATT notifications and indications for various simulated BLE services.

	*/
    while (1)
    {
        k_sleep(MSEC_PER_SEC);

        /* Current Time Service updates only when time is changed */
        cts_notify(); //Current Time Service

        /* Heartrate measurements simulation */
        hrs_notify(); // Heart Rate Service

        /* Battery level simulation */
        bas_notify(); // Battery Service

        /* Vendor indication simulation */
        // after client enables indication, this simulate_vnd is turned on (i.e., true or 1)
        if (simulate_vnd) //if(1) means true in C
        {
            if (indicating)
            {
                continue;
            }

            ind_params.attr = &vnd_svc.attrs[2];
            ind_params.func = indicate_cb;
            ind_params.data = &indicating;
            ind_params.len = sizeof(indicating);

            if (bt_gatt_indicate(NULL, &ind_params) == 0)
            {
                indicating = 1U;
            }
        }
    }
}
~~~~

## src/cts.c
```c
/** @file
 *  @brief CTS Service sample
 */

/*
 * Copyright (c) 2016 Intel Corporation
 *
 * SPDX-License-Identifier: Apache-2.0
 */

/**
The cts.c file implements a simple example of the Bluetooth Low Energy (BLE) Current Time Service (CTS) using the Zephyr RTOS. This service allows a BLE peripheral to expose the current time to a connected central device such as a phone or tablet. At the top of the file, several headers from Zephyr’s core, Bluetooth stack, and system utilities are included to provide the necessary types, macros, and functions.

The service uses two global static variables: ct, a 10-byte array that stores the current time information in a specific format defined by the Bluetooth CTS specification; and ct_update, a flag used to indicate whether the time value has been updated and needs to be notified to the client. The time format stored in ct includes fields for year, month, day, hour, minute, second, day of the week, fractions of a second, and an adjustment reason, making it compliant with the Bluetooth specification for the "Exact Time 256" structure.

The function read_ct allows a connected client to read the current time by copying data from ct into the response buffer using Zephyr's bt_gatt_attr_read. Meanwhile, write_ct permits a client to write new time data into the buffer. It validates the write by checking that the offset and length do not exceed the buffer’s size and sets the ct_update flag, which marks the time as changed and eligible for notification. There's also a function ct_ccc_cfg_changed that is meant to handle changes to the Client Characteristic Configuration descriptor (CCC), such as when a client enables or disables notifications, but in this code it's just a placeholder and does nothing yet.

The actual BLE service is defined with BT_GATT_SERVICE_DEFINE, which registers a primary CTS service and its associated characteristic. The characteristic supports read, write, and notify operations and is backed by the ct buffer. Additionally, a CCC descriptor is defined so clients can subscribe to notifications when the time value changes.

To populate the ct buffer, the function generate_current_time is used. It hardcodes a specific timestamp — year 2015, May 30th, 12:45:30 — along with day of the week, fractional seconds, and adjustment reason. This simulated time is set during initialization by the cts_init function.

The cts_notify function is used to send notifications to clients but only if the ct_update flag is set, which happens when the client writes new time data. After notifying, the flag is cleared. This ensures notifications are only sent when there’s actually a change to report. The notification itself is sent using Zephyr’s bt_gatt_notify, targeting the correct attribute inside the CTS service definition.

Overall, this file offers a minimal but complete implementation of a standard BLE service in Zephyr. While it uses a hardcoded time for simplicity, it correctly demonstrates how to define GATT services, characteristics, and descriptors; handle read/write requests; and push notifications to BLE clients. This structure can be extended by adding real-time clock integration or dynamically updating the time fields based on system state.
**/

#include <zephyr/types.h>
#include <stddef.h>
#include <string.h>
#include <errno.h>
#include <sys/printk.h>
#include <sys/byteorder.h>
#include <zephyr.h>

#include <bluetooth/bluetooth.h>
#include <bluetooth/hci.h>
#include <bluetooth/conn.h>
#include <bluetooth/uuid.h>
#include <bluetooth/gatt.h>

static u8_t ct[10];
static u8_t ct_update;

static void ct_ccc_cfg_changed(const struct bt_gatt_attr *attr, u16_t value)
{
	/* TODO: Handle value */
}

static ssize_t read_ct(struct bt_conn *conn, const struct bt_gatt_attr *attr,
		       void *buf, u16_t len, u16_t offset)
{
	const char *value = attr->user_data;

	return bt_gatt_attr_read(conn, attr, buf, len, offset, value,
				 sizeof(ct));
}

static ssize_t write_ct(struct bt_conn *conn, const struct bt_gatt_attr *attr,
			const void *buf, u16_t len, u16_t offset,
			u8_t flags)
{
	u8_t *value = attr->user_data;

	if (offset + len > sizeof(ct)) {
		return BT_GATT_ERR(BT_ATT_ERR_INVALID_OFFSET);
	}

	memcpy(value + offset, buf, len);
	ct_update = 1U;

	return len;
}

/* Current Time Service Declaration */
BT_GATT_SERVICE_DEFINE(cts_cvs,
	BT_GATT_PRIMARY_SERVICE(BT_UUID_CTS),
	BT_GATT_CHARACTERISTIC(BT_UUID_CTS_CURRENT_TIME, BT_GATT_CHRC_READ |
			       BT_GATT_CHRC_NOTIFY | BT_GATT_CHRC_WRITE,
			       BT_GATT_PERM_READ | BT_GATT_PERM_WRITE,
			       read_ct, write_ct, ct),
	BT_GATT_CCC(ct_ccc_cfg_changed, BT_GATT_PERM_READ | BT_GATT_PERM_WRITE),
);

static void generate_current_time(u8_t *buf)
{
	u16_t year;

	/* 'Exact Time 256' contains 'Day Date Time' which contains
	 * 'Date Time' - characteristic contains fields for:
	 * year, month, day, hours, minutes and seconds.
	 */

	year = sys_cpu_to_le16(2015);
	memcpy(buf,  &year, 2); /* year */
	buf[2] = 5U; /* months starting from 1 */
	buf[3] = 30U; /* day */
	buf[4] = 12U; /* hours */
	buf[5] = 45U; /* minutes */
	buf[6] = 30U; /* seconds */

	/* 'Day of Week' part of 'Day Date Time' */
	buf[7] = 1U; /* day of week starting from 1 */

	/* 'Fractions 256 part of 'Exact Time 256' */
	buf[8] = 0U;

	/* Adjust reason */
	buf[9] = 0U; /* No update, change, etc */
}

void cts_init(void)
{
	/* Simulate current time for Current Time Service */
	generate_current_time(ct);
}

void cts_notify(void)
{	/* Current Time Service updates only when time is changed */
	if (!ct_update) {
		return;
	}

	ct_update = 0U;
	bt_gatt_notify(NULL, &cts_cvs.attrs[1], &ct, sizeof(ct));
}
```
