## ZephyrOS/zephyr/firewall/Kconfig
```kconfig
menu "Device Drivers"

config USE_PERIPHERAL_FILTER
	bool
	default y
	help
		Enable the use of the peripheral filter.

endmenu
```

## contributions_folder/Mynewt/repos/tinyusb/examples/device/board_test/sdkconfig.defaults
```kconfig
# Lines added by author
CONFIG_IDF_CMAKE=y
CONFIG_FREERTOS_WATCHPOINT_END_OF_STACK=y
CONFIG_FREERTOS_SUPPORT_STATIC_ALLOCATION=y
```
