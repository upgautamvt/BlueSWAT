# Lines added by author
			return 0;
			// IFW below
			// IFW_DEBUG_LOG("Invoke ull_conn_setup here.");
			// IFW above


#endif /* CONFIG_BT_OBSERVER ||
	* CONFIG_BT_CTLR_SCAN_REQ_NOTIFY ||
	* CONFIG_BT_CTLR_PROFILE_ISR ||
	* CONFIG_BT_CTLR_ADV_INDICATION ||
	* CONFIG_BT_CTLR_SCAN_INDICATION ||
	* CONFIG_BT_CONN
	*/
			// IFW_DEBUG_LOG_CHECK_FAILURE("Packet drop.");
			// ll_rx_put(link, rx);
			// ll_rx_sched();
// mymacro
#if defined(CONFIG_USE_PERIPHERAL_FILTER)
#endif
		IFW_LL_PACKET_PARSER(link, rx);

		int res;
		res = IFW_LL_PACKET_PARSER(link, rx);

		if (res == IFW_OPERATION_REJECT) {
#ifdef CONFIG_USE_PERIPHERAL_FILTER
	err = IFW_FSM_STATE_UPDATE(IFW_BLE_LL_STANDBY_STATE, LL_STATE, CORE);
	if (err) {
		IFW_DEBUG_LOG_UPDATE_ERROR();
		return err;
	}
	IFW_DEBUG_LOG_UPDATE_SUCCESS(
		"IFW_BLE_LL_STANDBY_STATE, LL_STATE, CORE");
#endif
#ifdef CONFIG_USE_PERIPHERAL_FILTER
	err = IFW_FSM_STATE_UPDATE(IFW_BLE_ROLE_BROADCASTER, BLE_ROLE, CORE);
	if (err) {
		IFW_DEBUG_LOG_UPDATE_ERROR();
		return err;
	}
	IFW_DEBUG_LOG_UPDATE_SUCCESS(
		"IFW_BLE_ROLE_BROADCASTER, BLE_ROLE, CORE");
#endif
	err = IFW_FSM_STATE_UPDATE(IFW_BLE_ROLE_OBSERVER, BLE_ROLE, CORE);
	if (err) {
		IFW_DEBUG_LOG_UPDATE_ERROR();
		return err;
	}
	IFW_DEBUG_LOG_UPDATE_SUCCESS("IFW_BLE_ROLE_OBSERVER, BLE_ROLE, CORE");
// IFW below
#ifdef CONFIG_USE_PERIPHERAL_FILTER
	if (IS_ENABLED(CONFIG_BT_PERIPHERAL)) {
		err = IFW_FSM_STATE_UPDATE(IFW_BLE_ROLE_PERIPHERAL, BLE_ROLE,
					   CORE);
		if (err) {
			IFW_DEBUG_LOG_UPDATE_ERROR();
			return err;
		}

		IFW_DEBUG_LOG_UPDATE_SUCCESS(
			"IFW_BLE_ROLE_PERIPHERAL, BLE_ROLE, CORE");
	}
	if (IS_ENABLED(CONFIG_BT_CENTRAL)) {
		err = IFW_FSM_STATE_UPDATE(IFW_BLE_ROLE_CENTRAL, BLE_ROLE,
					   CORE);
		if (err) {
			IFW_DEBUG_LOG_UPDATE_ERROR();
			return err;
		}

		IFW_DEBUG_LOG_UPDATE_SUCCESS(
			"IFW_BLE_ROLE_CENTRAL, BLE_ROLE, CORE");
	}
#endif
